## boards/knockoff/nice_nano_v2/Kconfig.defconfig
```kconfig
if BOARD_NICE_NANO_V2

config BOARD
    default "nice_nano_v2"

config USB_NRFX
    default y if USB_DEVICE_STACK

config BT_CTLR
    default BT

endif
```

## boards/knockoff/nice_nano_v2/Kconfig.nice_nano_v2
```kconfig
config BOARD_NICE_NANO_V2
    bool "nice!nano v2"
    depends on SOC_NRF52840_QIAA
```

## boards/knockoff/nice_nano_v2/nice_nano_v2_defconfig
```kconfig
# Processor/Board Configuration
CONFIG_SOC_SERIES_NRF52X=y
CONFIG_SOC_NRF52840_QIAA=y
CONFIG_BOARD_NICE_NANO_V2=y

# Enable MPU
CONFIG_ARM_MPU=y
CONFIG_MPU_ALLOW_FLASH_WRITE=y

# Enable Pin Controller Drivers
CONFIG_PINCTRL=y

# Enable GPIO Drivers
CONFIG_GPIO=y

# Configure Output (UF2) and Code Partition
CONFIG_USE_DT_CODE_PARTITION=y
CONFIG_BUILD_OUTPUT_UF2=y

# Enable NVS (Non-Volatile Storage) support
CONFIG_NVS=y
CONFIG_SETTINGS=y
CONFIG_SETTINGS_NVS=y

# Enable Flash Driver
CONFIG_FLASH=y
CONFIG_FLASH_PAGE_LAYOUT=y
CONFIG_FLASH_MAP=y
```

## boards/nice/nice_nano_v2/Kconfig
```kconfig
config BOARD_ENABLE_DCDC
    bool "Enable DCDC mode"
    select SOC_DCDC_NRF52X
    default y
    depends on BOARD_NICE_NANO_V2

config BOARD_ENABLE_DCDC_HV
    bool "High voltage DCDC converter"
    select SOC_DCDC_NRF52X_HV
    default y
    depends on (BOARD_NICE_NANO_V2)

config BOARD_SERIAL_BACKEND_CDC_ACM
	bool "USB CDC"
	default y
```

## boards/nice/nice_nano_v2/Kconfig.defconfig
```kconfig
if BOARD_NICE_NANO_V2

config BOARD
    default "nice_nano_v2"

if BOARD_SERIAL_BACKEND_CDC_ACM

config UART_INTERRUPT_DRIVEN
    default y

config USB_DEVICE_STACK
	default y

config USB_CDC_ACM
	default SERIAL

config CONSOLE
	default y

config UART_CONSOLE
	default CONSOLE

config USB_DEVICE_INITIALIZE_AT_BOOT
	default y if !MCUBOOT && CONSOLE

config SHELL_BACKEND_SERIAL_CHECK_DTR
	default SHELL
	depends on UART_LINE_CTRL

config UART_LINE_CTRL
	default SHELL

config USB_DEVICE_REMOTE_WAKEUP
	default n

if LOG

# Logger cannot use itself to log
choice USB_CDC_ACM_LOG_LEVEL_CHOICE
	default USB_CDC_ACM_LOG_LEVEL_OFF
endchoice

# Set USB log level to error only
choice USB_DEVICE_LOG_LEVEL_CHOICE
	default USB_DEVICE_LOG_LEVEL_ERR
endchoice

# Wait 4000ms at startup for logging
config LOG_PROCESS_THREAD_STARTUP_DELAY_MS
	default 4000

endif # LOG

if USB_DEVICE_STACK

# Enable UART driver, needed for CDC ACM
config SERIAL
	default y

endif # USB_DEVICE_STACK

endif # BOARD_SERIAL_BACKEND_CDC_ACM

config USB_NRFX
    default y
    depends on USB_DEVICE_STACK

config BT_CTLR
    default BT

endif # BOARD_NICE_NANO_V2
```

## boards/nice/nice_nano_v2/nice_nano_v2_defconfig
```kconfig
CONFIG_HW_STACK_PROTECTION=y

# Enable/Configure MPU
CONFIG_ARM_MPU=y
CONFIG_MPU_ALLOW_FLASH_WRITE=y

# Enable pin controller drovers
CONFIG_PINCTRL=y

# Enable GPIO drivers
CONFIG_GPIO=y

# Configure UF2 Output
CONFIG_USE_DT_CODE_PARTITION=y
CONFIG_BUILD_OUTPUT_UF2=y

# Configure Non-Volatile Storage
CONFIG_NVS=y

# Configure Settings
CONFIG_SETTINGS=y
CONFIG_SETTINGS_NVS=y

# Configure Flash
CONFIG_FLASH=y
CONFIG_FLASH_PAGE_LAYOUT=y
CONFIG_FLASH_MAP=y
```
